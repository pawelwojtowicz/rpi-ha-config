## conf/bblayers.conf
```bitbake
# POKY_BBLAYERS_CONF_VERSION is increased each time build/conf/bblayers.conf
# changes incompatibly
POKY_BBLAYERS_CONF_VERSION = "2"

BBPATH = "${TOPDIR}"
BBFILES ?= ""

BBLAYERS ?= " \
  /home/ibisdev/rpiYocto/poky/meta \
  /home/ibisdev/rpiYocto/poky/meta-poky \
  /home/ibisdev/rpiYocto/poky/meta-yocto-bsp \
  /home/ibisdev/rpiYocto/poky/meta-raspberrypi \
  /home/ibisdev/rpiYocto/poky/meta-openembedded/meta-networking \
  /home/ibisdev/rpiYocto/poky/meta-openembedded/meta-webserver \
  /home/ibisdev/rpiYocto/poky/meta-openembedded/meta-python \
  /home/ibisdev/rpiYocto/poky/meta-wojtech \
  /home/ibisdev/rpiYocto/poky/meta-openembedded/meta-oe \
  "
```
